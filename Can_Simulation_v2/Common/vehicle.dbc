VERSION ""

NS_ :

BS_:

BU_: ENGINE CHASSIS BODY DIAG DASHBOARD FAULTY

BO_ 128 EngineData: 2 ENGINE
 SG_ RPM : 0|16@1+ (1,0) [0|8000] "rpm" DASHBOARD

BO_ 256 ChassisData: 2 CHASSIS
 SG_ SPEED : 0|16@1+ (1,0) [0|300] "kmph" DASHBOARD

BO_ 768 BodyData: 1 BODY
 SG_ TEMP : 0|8@1+ (2,0) [-40|150] "degC" DASHBOARD

BO_ 1792 DiagData: 1 DIAG
 SG_ DIAG_CNT : 0|8@1+ (1,0) [0|255] "" DASHBOARD
